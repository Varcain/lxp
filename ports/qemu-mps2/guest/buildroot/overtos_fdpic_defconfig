## ports/qemu-mps2/guest/buildroot/overtos_fdpic_defconfig
```kconfig
BR2_arm=y
BR2_cortex_m4=y
BR2_BINFMT_FDPIC=y
BR2_PTHREADS=y
# BR2_UCLIBC_INSTALL_UTILS is not set
BR2_ENABLE_LTO=y
BR2_DOWNLOAD_FORCE_CHECK_HASHES=y
BR2_ROOTFS_OVERLAY="board/overtos/rootfs-overlay"
BR2_ROOTFS_POST_BUILD_SCRIPT="board/overtos/post-build.sh"
BR2_PACKAGE_BUSYBOX_CONFIG="board/overtos/busybox.config"
BR2_PACKAGE_OVERTOS_LVBENCH=y
# BR2_PACKAGE_IFUPDOWN_SCRIPTS is not set
BR2_TARGET_ROOTFS_CPIO=y
# BR2_TARGET_ROOTFS_TAR is not set
```
